/*
 * CAUTION: This file is automatically generated by Xilinx.
 * Version:  
 * Today is: Sat Jul 16 13:26:59 2016
*/


/ {
	amba_pl: amba_pl {
		#address-cells = <1>;
		#size-cells = <1>;
		compatible = "simple-bus";
		ranges ;
		heartbeat_0: heartbeat@43c00000 {
			compatible = "xlnx,heartbeat-1.0";
			reg = <0x43c00000 0x10000>;
			xlnx,hb-axi-addr-width = <0x4>;
			xlnx,hb-axi-data-width = <0x20>;
		};
	};
};
